## esp-app/main/Kconfig.projbuild
```kconfig
menu "ADC Config"
    orsource "$IDF_PATH/examples/common_components/env_caps/$IDF_TARGET/Kconfig.env_caps"

    config ADC1_pin 
        int "ADC1 pin number"
        default 0

endmenu 

menu "UART Config"

    config RX_pin
        int "RX pin number"
        default 1

    config TX_pin 
        int "TX pin number"
        default 3

endmenu
```

## esp_project/main/Kconfig.projbuild
```kconfig
menu "GPIO config"
    config TEST_GPIO
        int "GPIO number for test"
    
    config GROUP_NUM
        int "Timer group number, 0 for TIMERG0 or 1 for TIMERG1"
        default 0 

    config TIMER_NUM 
        int "Timer index, 0 for hw_timer[0] & 1 for hw_timer[1]"    
        default 0

    config TIMER_CONFIG  
            

endmenu
```

## main/Kconfig.projbuild
```kconfig
menu "GPIO Configuration"

    orsource "$IDF_PATH/examples/common_components/env_caps/$IDF_TARGET/Kconfig.env_caps"
    
    config ADC1_PIN
        int "ADC1 pin number"
        range 0 40
        default 0

endmenu
```
